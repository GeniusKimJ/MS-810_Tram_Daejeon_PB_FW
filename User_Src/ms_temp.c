/**================================================================================================*
*       Source File                                                                                *
*==================================================================================================*
*       [Project]    : ms_810P(Temp)                                                               *
*       [Version]    : 1.0                                                                         *
*       [Start]      : 2025-11-21                                                                  *
*       [Inventor]   : www.misum.co.kr                                                             *
*       Copyright(C) 2025 Misum Systech Co.,Ltd. All Rights Reserved.                              *
*==================================================================================================*
** For Doxygen ******************************
\file               ms_temp.c
\author             KKD
\date               2025-11-21 
\brief              온도 센서 동작을 위한 코드.
*********************************************
* History:
* 2025-11-21     v0.01    KKD    Create
*==================================================================================================*/
/* Includes ---------------------------------------------------------------------------------------*/
#include <ms_temp.h>

/* Private define ---------------------------------------------------------------------------------*/
/* Private macro ----------------------------------------------------------------------------------*/
/* Private typedef --------------------------------------------------------------------------------*/
/* Private variables ------------------------------------------------------------------------------*/
/* Private function prototypes --------------------------------------------------------------------*/
/* Private functions ------------------------------------------------------------------------------*/
s16 TempAmbient(u16 adc) 
{
	static const u16 Th103AT[142U] = {	// -50 ~ 90 degree(15-bit extended data) after 250321
	   31522,    31463,  31400,    31335, 	 31268,	  31197,  31124,    31047, 30969,  30888,
	   30798,    30727,  30650,    30567,    30477,   30379,  30273,    30158, 30030,  29890,
	   29735,    29631,  29520,    29402,    29274,   29136,  28986,    28824, 28648,  28454,
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	   3679,     3604
	};


	u8		quota = (sizeof(Th103AT)/sizeof(s16))/8U;
	s16		data, denom;
	u16     u16_buf;
	u16     u16_buf2;
	s16     s16_buf;
	//u8		uint8_buf;

	if(adc > Th103AT[quota*4U]) {
		if(adc > Th103AT[quota*2U])	{
			if(adc > (u16)Th103AT[quota]) {
				quota = 0U;
			}
			//else						quota = quota * 1U;
		} else {
			if(adc > Th103AT[quota*3U]) {
				quota = quota * 2U;
			} else {
				quota = quota * 3U;
			}
		}
	} else {
		if(adc > Th103AT[quota*6U]) {
			if(adc > Th103AT[quota*5U]) {
				quota = quota * 4U;
			} else {
				quota = quota * 5U;
			}
		} else {
			if(adc > Th103AT[quota*7U])	{
				quota = quota * 6U;
			} else {
				quota = quota * 7U;
			}
		}
	}

	for(; quota < (sizeof(Th103AT)/sizeof(s16)); quota++) {			// Scan 0 ~ 100?
		if(adc >= Th103AT[quota]) {
			break;
		}
	}

	if(quota > ((sizeof(Th103AT)/sizeof(s16))-1U)) {
		quota = (u8)((sizeof(Th103AT)/sizeof(s16))-1U); // quota Max 141
	}
	if(quota == 0U) {
		data = -500;		// Open or under -50.1 - kDk
	} else if(quota == 141U) {
		data = (s16)900L;
	} else {
		//data = (s16)((adc - Th103AT[quota]) * 10U);					// For rerolution 0.1?
		u16_buf = Th103AT[quota];
		u16_buf = (adc - u16_buf) * 10U;
		data = (s16)(u16_buf);

		//denom = Th103AT[quota-1] - Th103AT[quota];
		//uint8_buf = quota-1U;
		u16_buf = Th103AT[quota-1U];
		u16_buf2 = Th103AT[quota];
		u16_buf = u16_buf - u16_buf2;
		denom = (s16)(u16_buf);

		//data = (((quota * 10U) - (data / denom)) - 400U);					// 1? Table
		u16_buf = (u16)((u16)quota * 10U);
		s16_buf = (s16)(data / denom);
		u16_buf2 = (u16)s16_buf;
		u16_buf = (u16_buf - u16_buf2) - (u16)500U;
		data = (s16)(u16_buf);

		if(data > 1400L) {
			data = (s16)1400L;
		}
	}
	return	data;
}

/**************************  End Of Source  *******************************************************/



